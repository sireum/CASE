## CASE_simple_example/AADL/tb/PROC_HW/make_template/Kconfig
```kconfig
config APP_PROC_HW
    bool "PROC_HW (from AADL)"
    default n
    select APP_CAMKES_EXECUTIVE
    help
        PROC_HW (from AADL).

config APP_PROC_HW_TB_DEBUG
    bool "Enable trusted build debugging for the PROC_HW application"
    default n
    depends on APP_PROC_HW && PRINTING
    help
        Enable trusted build debugging for the PROC_HW application.
```

## CASE_simple_example/AADL/tb/PROC_HW/make_vm_template/Kconfig
```kconfig
config APP_PROC_HW
    bool "PROC_HW (from AADL)"
    default n
    depends on LIB_SEL4 && (LIB_MUSL_C || LIB_SEL4_C) && LIB_SEL4_VKA && LIB_SEL4_VMM && LIB_SEL4_UTILS && LIB_UTILS && LIB_SEL4_SIMPLE && LIB_SEL4_SIMPLE_DEFAULT && LIB_SEL4_PLAT_SUPPORT && LIB_LWIP
    help
        PROC_HW (from AADL).
```

## models/UxAS/AADL_project/aadl/models/tb/uxas_processor/make_template/Kconfig
```kconfig
config APP_UXAS_PROCESSOR
    bool "uxas_processor (from AADL)"
    default n
    select APP_CAMKES_EXECUTIVE
    help
        uxas_processor (from AADL).

config APP_UXAS_PROCESSOR_TB_DEBUG
    bool "Enable trusted build debugging for the UXAS_PROCESSOR application"
    default n
    depends on APP_UXAS_PROCESSOR && PRINTING
    help
        Enable trusted build debugging for the UXAS_PROCESSOR application.
```

## models/aadl_connection_examples/tb/proc/make_template/Kconfig
```kconfig
config APP_PROC
    bool "proc (from AADL)"
    default n
    select APP_CAMKES_EXECUTIVE
    help
        proc (from AADL).

config APP_PROC_TB_DEBUG
    bool "Enable trusted build debugging for the PROC application"
    default n
    depends on APP_PROC && PRINTING
    help
        Enable trusted build debugging for the PROC application.
```
